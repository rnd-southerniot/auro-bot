## firmware/esp32s3_voice_buddy/sdkconfig.defaults
```kconfig
# ESP32-S3 Voice Buddy — IDF defaults (PlatformIO seeds sdkconfig from this).

# --- Target / flash / PSRAM (N16R8: 16 MB flash, 8 MB octal PSRAM) ---
CONFIG_IDF_TARGET="esp32s3"
CONFIG_ESPTOOLPY_FLASHSIZE_16MB=y

# --- Partition table (native idf.py; PlatformIO set this via board_build) ---
CONFIG_PARTITION_TABLE_CUSTOM=y
CONFIG_PARTITION_TABLE_CUSTOM_FILENAME="partitions.csv"
CONFIG_SPIRAM=y
CONFIG_SPIRAM_MODE_OCT=y
CONFIG_SPIRAM_SPEED_80M=y
CONFIG_ESP_DEFAULT_CPU_FREQ_MHZ_240=y

# --- Console OFF UART0: that UART is the CH343/Pi link (PROTOCOL.md). ---
# Keeps the 1 Mbps binary link clean of stray log bytes. Flip to UART for
# bring-up debugging only (accepting log noise on the link).
CONFIG_ESP_CONSOLE_NONE=y

# --- FreeRTOS / misc ---
CONFIG_FREERTOS_HZ=1000
CONFIG_ESP_TASK_WDT_INIT=n
CONFIG_COMPILER_OPTIMIZATION_PERF=y

# --- esp-sr: AFE + WakeNet (Jarvis) + MultiNet (English) ---
CONFIG_MODEL_IN_FLASH=y                 # models live in the "model" flash partition
CONFIG_AFE_INTERFACE_V1=y
CONFIG_SR_NSN_WEBRTC=y                   # WebRTC noise-suppress (no extra model binary)
CONFIG_SR_VADN_WEBRTC=y                  # WebRTC VAD (no extra model binary)
CONFIG_SR_WN_WN9_JARVIS_TTS=y           # wake word "Jarvis" (swap later for Hey Auro model)
CONFIG_SR_MN_EN_MULTINET7_QUANT=y       # English MultiNet7 -> runtime commands "stop"/"halt"
```

## firmware/xiao_esp32s3_sense_cam/firmware/main/Kconfig.projbuild
```kconfig
menu "Phase 5 — App configuration"

    config WIFI_SSID
        string "Wi-Fi SSID"
        default ""
        help
            SSID of the Wi-Fi access point to join. Leave empty to skip
            Wi-Fi bring-up (phase5_net_start_blocking will fail fast with
            a clear error in that case).

    config WIFI_PASSWORD
        string "Wi-Fi password"
        default ""
        help
            WPA2-PSK password. Leave empty for open networks.

    config WIFI_CONNECT_TIMEOUT_MS
        int "Wi-Fi connect timeout (ms)"
        range 1000 120000
        default 30000
        help
            Maximum time phase5_net_start_blocking will wait for an IP
            address before returning ESP_ERR_TIMEOUT.

    config WIFI_MAX_RETRY
        int "Wi-Fi connect retry count"
        range 1 100
        default 10
        help
            Number of esp_wifi_connect() retries triggered on
            WIFI_EVENT_STA_DISCONNECTED before giving up. Each retry
            inserts a small backoff.

endmenu
```

## firmware/xiao_esp32s3_sense_cam/firmware/sdkconfig.defaults
```kconfig
# Defaults for XIAO ESP32-S3 Sense (N8R8: 8 MB QIO flash, 8 MB Octal PSRAM)
# Project-specific overrides only. Leave everything else at IDF defaults.

# --- Target ---
CONFIG_IDF_TARGET="esp32s3"

# --- Flash ---
CONFIG_ESPTOOLPY_FLASHSIZE_8MB=y
CONFIG_ESPTOOLPY_FLASHMODE_QIO=y
CONFIG_ESPTOOLPY_FLASHFREQ_80M=y

# --- PSRAM (8 MB Octal @ 80 MHz, AP_3v3 die) ---
CONFIG_SPIRAM=y
CONFIG_SPIRAM_MODE_OCT=y
CONFIG_SPIRAM_SPEED_80M=y
CONFIG_SPIRAM_USE_MALLOC=y
CONFIG_SPIRAM_MALLOC_ALWAYSINTERNAL=16384
CONFIG_SPIRAM_TRY_ALLOCATE_WIFI_LWIP=y

# --- CPU ---
CONFIG_ESP_DEFAULT_CPU_FREQ_MHZ_240=y

# --- Console: native USB-Serial/JTAG (no UART bridge on this board) ---
CONFIG_ESP_CONSOLE_USB_SERIAL_JTAG=y

# --- Partition table (single app, large = fits 8 MB device) ---
CONFIG_PARTITION_TABLE_SINGLE_APP_LARGE=y

# --- Logging ---
CONFIG_LOG_DEFAULT_LEVEL_INFO=y
CONFIG_BOOTLOADER_LOG_LEVEL_INFO=y

# --- lwIP socket pool: default 10 is too tight for parallel browser
#     connections (stream + polling) plus MQTT plus background curl.
#     Bump so esp_http_server can serve more concurrent clients. ---
CONFIG_LWIP_MAX_SOCKETS=16

# --- Watchdog: keep IDF defaults (Task WDT 5 s on both cores) ---
```
